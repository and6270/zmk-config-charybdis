/*
 * Copyright (c) 2024 The ZMK Contributors
 * SPDX-License-Identifier: MIT
 * 
 * Charybdis right keyboard - Standalone mode (acts as central)
 * Processes trackball input locally
 */

#include "charybdis_right_common.dtsi"
#include "charybdis_trackball_processors.dtsi"

&trackball_split {
    device = <&trackball>;
};