/*
 * Copyright (c) 2024 The ZMK Contributors
 * SPDX-License-Identifier: MIT
 * 
 * Common trackball input processor configurations for Charybdis keyboard
 * This file defines the standard processing for snipe, scroll, and move modes
 * 
 * Usage: Include this file and define CHARYBDIS_TRACKBALL_LISTENER macro
 * Example:
 *   #define CHARYBDIS_TRACKBALL_LISTENER snipe { layers = <SNIPING>; input-processors = <&zip_xy_scaler 1 3>; }; scroll { layers = <SCROLL>; input-processors = <&zip_xy_transform (INPUT_TRANSFORM_Y_INVERT)>, <&zip_xy_scaler 1 20>, <&zip_xy_to_scroll_mapper>; }; move { layers = <BASE POINTER>; input-processors = <&zip_xy_scaler 7 6>; };
 */

#include "charybdis_layers.h"
#include <dt-bindings/zmk/input_transform.h>
#include <input/processors.dtsi>
#include <zephyr/dt-bindings/input/input-event-codes.h>

// Standard trackball processing configuration
// Can be used in both standalone (trackball_listener) and dongle mode (input_split_listener)
#define CHARYBDIS_TRACKBALL_PROCESSORS \
    snipe { \
        layers = <SNIPING>; \
        input-processors = <&zip_xy_scaler 1 3>; \
    }; \
    \
    scroll { \
        layers = <SCROLL>; \
        input-processors = <&zip_xy_transform (INPUT_TRANSFORM_Y_INVERT)>, <&zip_xy_scaler 1 40>, <&zip_xy_to_scroll_mapper>; \
    }; \
    \
    move { \
        layers = <BASE>; \
        input-processors = <&zip_temp_layer POINTER 1000>; \
    };

/ {
    /omit-if-no-ref/ zip_temp_layer: zip_temp_layer {
        compatible = "zmk,input-processor-temp-layer";
        #input-processor-cells = <2>;
        require-prior-idle-ms = <1000>;
        excluded-positions = <1 2 3>;
    };
};